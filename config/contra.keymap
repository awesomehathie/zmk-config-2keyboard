/ {
    keymap {
        compatible = "zmk,keymap";

        default_layer {
            bindings = <
                &kp LC(C)   // Ctrl + C (Copy)
                &kp LC(V)   // Ctrl + V (Paste)
            >;
        };
    };
};